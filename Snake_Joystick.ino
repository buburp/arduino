#include <LedControl.h>
#include <pitches.h>

const int pinClick = 2, pinMovX = 0, pinMovY = 1, pinBuzzer = 8, snake_maxlen = 3;  // Pin del joypad (2, A0, A1)
int i, posX, posY, ritardo = 200, snake_currlen = 1, riga[snake_maxlen], col[snake_maxlen], cibo[2], oldhead[2], semiminima = 750;
char ultima_dir = 'N';
bool snake_has_moved, ciboblink, vialibera, cannibale, gnam = true;
LedControl lc=LedControl(12,10,11,1); // pin 12 = DataIn; pin 11= LOAD(CS); pin 10= CLK ; 1 = numero di matrici a led

void setup() {
  lc.shutdown(0,false); // Risveglia dallo stand-by iniziale di default la matrice con indice 0 (va bè, è l'unica del circuito)
  lc.setIntensity(0,0); // 0 indice matrice; 8 luminosità (default 0 min - 15 max)
  riga[0] = 4;
  col[0] = 4;
}

void newcibo() {
  do {
    randomSeed(analogRead(2));
    cibo[0] = (int)random(8);
    cibo[1] = (int)random(8);
    vialibera = true;
    for (i=0; i<snake_currlen && vialibera; i++) {
      if ((pow(cibo[0]-riga[i],2) + pow(cibo[1]-col[i],2)) < 9) vialibera = false;  // CIBO NON TROPPO VICINO AL SERPENTACCIO
    }
  } while (!vialibera);
  gnam = false;
}

void vittoria() {
  snake_currlen = 0;
  byte deu[7]={B1001111,B1001000,B1001000,B1111111,B0001001,B0001001,B1111001};
  lc.clearDisplay(0);
  for (i=0; i<7; i++) lc.setRow(0,i,deu[i]);
  tone(pinBuzzer, NOTE_G4, semiminima * 1.5);
  delay (semiminima * 1.5); // NOTA PRECEDENTE + PAUSA
  tone(pinBuzzer, NOTE_A4, semiminima / 2);
  delay (semiminima / 2);
  tone(pinBuzzer, NOTE_B4, semiminima);
  delay (semiminima);
  tone(pinBuzzer, NOTE_A4, semiminima);
  delay (semiminima);
  tone(pinBuzzer, NOTE_C5, semiminima);
  delay (semiminima);
  tone(pinBuzzer, NOTE_B4, semiminima);
  delay (semiminima);
  tone(pinBuzzer, NOTE_A4, semiminima / 2);
  delay (semiminima / 2);
  tone(pinBuzzer, NOTE_FS4, semiminima / 2);
  delay (semiminima / 2);
  tone(pinBuzzer, NOTE_G4, semiminima);
  delay (semiminima);
  exit(0);
}

void sconfitta() {
  snake_currlen = 0;
  byte rus[8]={B00111001,B01000110,B10000100,B00001010,B01010010,B00100100,B00010010,B00000001};
  lc.clearDisplay(0);
  for (i=0; i<8; i++) lc.setRow(0,i,rus[i]);
  tone(pinBuzzer, NOTE_G4, semiminima);
  delay (semiminima); // NOTA PRECEDENTE + PAUSA
  tone(pinBuzzer, NOTE_C5, semiminima * 2);
  delay (semiminima * 3);
  tone(pinBuzzer, NOTE_G4, semiminima / 1.5);
  delay (semiminima / 1.5);
  tone(pinBuzzer, NOTE_C5, semiminima / 3);
  delay (semiminima / 3);
  tone(pinBuzzer, NOTE_E5, semiminima * 2);
  delay (semiminima * 2);
  exit(0);
}

void loop() {
  if (gnam) newcibo();
  posX = analogRead(pinMovX);
  posY = analogRead(pinMovY);
  if ((abs(posX-512) > 400) || (abs(posY-512) > 400)) snake_has_moved = true;
  if (snake_has_moved) {
    if (posY < 100) ultima_dir = 'N'; // Nord
    else if (posY > 900) ultima_dir = 'S'; // Sud
    else if (posX < 100) ultima_dir = 'W'; // Ovest
    else if (posX > 900) ultima_dir = 'E'; // Est
// INIZIO MUOVE LA TESTA DOPO AVER SALVATO LA POSIZIONE PRECEDENTE
    oldhead[0] = riga[0];
    oldhead[1] = col[0];
    if (ultima_dir == 'N') riga[0] = (7+riga[0]) % 8;
    else if (ultima_dir == 'S') riga[0] = ++riga[0] % 8;
    else if (ultima_dir == 'W') col[0] = (7+col[0]) % 8;
    else if (ultima_dir == 'E') col[0] = ++col[0] % 8;
// INIZIO CONTROLLO SE HA SBATTUTO CONTRO IL SUO CORPO
    for (i=1; i<snake_currlen && !cannibale; i++) {
      if (riga[i] == riga[0] && col[i] == col[0]) cannibale = true;
    }
    if (cannibale) sconfitta();
// FINE CONTROLLO SE HA SBATTUTO CONTRO IL SUO CORPO
// FINE MUOVE LA TESTA DOPO AVER SALVATO LA POSIZIONE PRECEDENTE
  if (riga[0] == cibo[0] && col[0] == cibo[1]) gnam = true; // CONTROLLA SE HA MANGIATO
// INIZIO IL CORPO SEGUE LA TESTA
    if (!gnam) {
      for (i=snake_currlen-1; i>1; i--) {
        riga[i] = riga[i-1];
        col[i] = col[i-1];
      }
      if (snake_currlen > 1) {
        riga[1] = oldhead[0];
        col[1] = oldhead[1];
      }
    }
    else {
      ++snake_currlen;
      for (i=snake_currlen-1; i>1; i--) {
        riga[i] = riga[i-1];
        col[i] = col[i-1];
      }
      riga[1] = oldhead[0];
      col[1] =oldhead[1];
    }
// FINE IL CORPO SEGUE LA TESTA
  }
  for (i=0; i < snake_currlen; i++) {
    lc.clearDisplay(0);
    ciboblink = !ciboblink;
    lc.setLed(0,cibo[0],cibo[1],ciboblink);
    for (i=0; i<snake_currlen; i++) lc.setLed(0,riga[i],col[i],true);
  }
  delay (ritardo);
  if (snake_currlen == snake_maxlen) vittoria();
}