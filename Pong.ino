#include <LedControl.h>
#include <pitches.h>
// AUTHOR: William Incicchitti
LedControl lc=LedControl(12,10,11,1); // pin 12 = DataIn; pin 11 = LOAD(CS); pin 10 = CLK; matrice orientata con i connettori a sx
const byte pinBuzzer = 8, pinJoy[2] = {A0,A1}; // Pin del buzzer e dei due joystick
const int semiminima = 1000, ritardoiniz = 200, ritardomin = 10, riduz_ritardo = 10, tempo_synth = 80, puntivittoria = 3;
int i, j, score[2], curcol, currig, oldcol, oldrig, ritardo, direzione, plr2srv, wonthepoint, battoppos[2], movJoy[2];
bool ingioco;
const byte cifra[30]={B111110,B100010,B111110,B000000,B000000,B111110,B101110,B101010,B111010,B101010,B101010,B111110,B111000,B001000,
  B111110, B111010,B101010,B101110,B111110,B101010,B101110,B100000,B100000,B111110,B111110,B101010,B111110,B111010,B101010,B111110};

void tabellone() {
  lc.clearDisplay(0);
  for (j=0; j<2; j++) for (i=0; i<3; i++) lc.setColumn(0,5*j+i,cifra[3*score[j]+i]);
}

void ontherun() {
  for (i=0; i<3; i++) {
    tone(pinBuzzer, NOTE_E3, tempo_synth);
    delay(tempo_synth);
    tone(pinBuzzer, NOTE_G3, tempo_synth);
    delay(tempo_synth);
    tone(pinBuzzer, NOTE_A3, tempo_synth);
    delay(tempo_synth);
    tone(pinBuzzer, NOTE_G3, tempo_synth);
    delay(tempo_synth);
    tone(pinBuzzer, NOTE_D4, tempo_synth);
    delay(tempo_synth);
    tone(pinBuzzer, NOTE_C4, tempo_synth);
    delay(tempo_synth);
    tone(pinBuzzer, NOTE_D4, tempo_synth);
    delay(tempo_synth);
    tone(pinBuzzer, NOTE_E4, tempo_synth);
    delay(tempo_synth);
  }
  tone(pinBuzzer, NOTE_E3, tempo_synth);
  delay(tempo_synth);
}

void wearethechampions() {
  tone(pinBuzzer, NOTE_F4, 4*semiminima/3);
  delay(4*semiminima/3);
  tone(pinBuzzer, NOTE_E4, semiminima/3);
  delay(semiminima/3);
  tone(pinBuzzer, NOTE_F4, semiminima/3);
  delay(semiminima/3);
  tone(pinBuzzer, NOTE_E4, 2*semiminima/3);
  delay(2*semiminima/3);
  tone(pinBuzzer, NOTE_C4, 2*semiminima/3);
  delay(semiminima);
  tone(pinBuzzer, NOTE_A3, semiminima/3);
  delay(semiminima/3);
  tone(pinBuzzer, NOTE_D4, 2*semiminima/3);
  delay(2*semiminima/3);
  tone(pinBuzzer, NOTE_A3, semiminima);
  delay(semiminima);
}

void servizio() {
    randomSeed(analogRead(4)); // Randomizza da porta vuota
    plr2srv = (score[0] + score[1]) % 2;
    curcol = 5*plr2srv + 1;
    currig = (int)random(8);
    if(currig == 0) direzione = 3 * plr2srv; // COL 0 ==> Obbligatoriamente verso SE or SW
    else if(currig == 7) direzione = 1 + plr2srv; // COL 7 ==> Obbligatoriamente verso NE or NW
    else direzione = (int)random(2) + 2*plr2srv; // SE=0; NE=1; NW=2; SW=3 (La palla non parte dalle linee laterali e va dove vuole)
    lc.clearDisplay(0);
    for (j=0; j<2; j++) {
      battoppos[j] = 3; // Memorizza la posizione (riga) più alta delle racchette (l'altra sta alla riga successiva)
      for (i=0; i<2; i++) lc.setLed(0,i+3,7*j,true); // Comparsa racchette sullo schermo (2 px)
    }
    delay(1000);
    lc.setLed(0,currig,curcol,true); // Compare la palla sullo schermo
    ingioco = true;
    ritardo = ritardoiniz; // Resetta la velocità iniziale
    delay(ritardo);
}

void setup() {
  lc.shutdown(0,false);
  lc.setIntensity(0,15); // indice matrice, luminosità (default 0 min - 15 max)
  for (j=3; j>0; j--) { // 3-2-1
    lc.clearDisplay(0);
    for (i=0; i<3; i++) lc.setColumn(0,i+2,cifra[3*j+i]);
    tone(pinBuzzer, NOTE_A5, semiminima/2);
    delay (semiminima);
  }
  tabellone();
  tone(pinBuzzer, NOTE_A6, semiminima); // Gate opened
  delay (semiminima * 2);
}

void loop() {
  if (score[0] == puntivittoria || score[1] == puntivittoria) {
    wearethechampions();
    exit(0);
  }
  if (!ingioco) servizio();
  oldcol = curcol;
  oldrig = currig;
  switch (direzione) {
    case 0: // Se va a SE ...
      curcol++;
      currig++;
      break;
    case 1: // Se va a NE ...
      curcol++;
      currig--;
      break;
    case 2: // Se va a NW ...
      curcol--;
      currig--;
      break;
    case 3: // Se va a SW ...
      curcol--;
      currig++;
  }
// INIZIO GESTIONE GOAL
  if (curcol == 7 && direzione < 2) { // P0 ha segnato
    score[0]++;
    ingioco = false;
    plr2srv = 1;
    lc.setLed(0,oldrig,oldcol,false);
    lc.setLed(0,currig,curcol,true);
    delay(ritardo);
    tabellone();
    ontherun();
    delay(1000);
  }
  else if (curcol == 0 && direzione > 1) { // P1 ha segnato
    score[1]++;
    ingioco = false;
    plr2srv = 0;
    lc.setLed(0,oldrig,oldcol,false);
    lc.setLed(0,currig,curcol,true);
    delay(ritardo);
    tabellone();
    ontherun();
    delay(1000);
  }
// FINE GESTIONE GOAL
// INIZIO GESTIONE RIMBALZI RACCHETTA
  else if (curcol == 6 && direzione == 0) { // La palla arriva a P1 viaggiando verso SE
    if (currig == battoppos[1] - 1) direzione = 2; // NW
    else if (currig == battoppos[1] || currig == battoppos[1] + 1) direzione = 3; // SW
    lc.setLed(0,oldrig,oldcol,false);
    lc.setLed(0,currig,curcol,true);
    if (direzione != 0 && ritardo > ritardomin) {
      tone(pinBuzzer, NOTE_A4, semiminima/16);
      delay (semiminima/16);
      ritardo -= riduz_ritardo;
    }
    delay(ritardo);
  }
  else if (curcol == 6 && direzione == 1) { // La palla arriva a P1 viaggiando verso NE
    if (currig == battoppos[1] + 2) direzione = 3; // SW
    else if (currig == battoppos[1] || currig == battoppos[1] + 1) direzione = 2; // NW
    lc.setLed(0,oldrig,oldcol,false);
    lc.setLed(0,currig,curcol,true);
    if (direzione != 1 && ritardo > ritardomin) {
      tone(pinBuzzer, NOTE_A4, semiminima/16);
      delay (semiminima/16);
      ritardo -= riduz_ritardo;
    }
    delay(ritardo);
  }
  else if (curcol == 1 && direzione == 2) { // La palla arriva a P0 viaggiando verso NW
    if (currig == battoppos[0] + 2) direzione = 0; // SE
    else if (currig == battoppos[0] || currig == battoppos[0] + 1) direzione = 1; // NE
    lc.setLed(0,oldrig,oldcol,false);
    lc.setLed(0,currig,curcol,true);
    if (direzione != 2 && ritardo > ritardomin) {
      tone(pinBuzzer, NOTE_A3, semiminima/16);
      delay (semiminima/16);
      ritardo -= riduz_ritardo;
    }
    delay(ritardo);
  }
  else if (curcol == 1 && direzione == 3) { // La palla arriva a P0 viaggiando verso SW
    if (currig == battoppos[0] - 1) direzione = 1; // NE
    else if (currig == battoppos[0] || currig == battoppos[0] + 1) direzione = 0; // SE
    lc.setLed(0,oldrig,oldcol,false);
    lc.setLed(0,currig,curcol,true);
    if (direzione != 3 && ritardo > ritardomin) {
      tone(pinBuzzer, NOTE_A3, semiminima/16);
      delay (semiminima/16);
      ritardo -= riduz_ritardo;
    }
    delay(ritardo);
  }
  else {
    lc.setLed(0,oldrig,oldcol,false);
    lc.setLed(0,currig,curcol,true);
    delay(ritardo);
  }
// FINE GESTIONE RIMBALZI RACCHETTA
// INIZIO GESTIONE RIMBALZI MURO
  if (score[0] < puntivittoria && score[1] < puntivittoria) {
    if (currig == 7 && direzione == 0) direzione = 1;
    else if (currig == 7 && direzione == 3) direzione = 2;
    else if (currig == 0 && direzione == 1) direzione = 0;
    else if (currig == 0 && direzione == 2) direzione = 3;
  }
// FINE GESTIONE RIMBALZI MURO
// INIZIO LETTURA JOYSTICK
  for (j=0; j<2; j++) {
    movJoy[j] = analogRead(pinJoy[j]);
    if (movJoy[j] < 250) {
      for (i=0; i<2; i++) lc.setLed(0,battoppos[j] + i, 7*j, false);
      if (score[0] < puntivittoria && score[1] < puntivittoria) {
        battoppos[j] = max(battoppos[j] - 1, 0);
        for (i=0; i<2; i++) lc.setLed(0,battoppos[j] + i, 7*j, true);
      }
    }
    else if (movJoy[j] > 750) {
      for (i=0; i<2; i++) lc.setLed(0,battoppos[j] + i, 7*j, false);
      if (score[0] < puntivittoria && score[1] < puntivittoria) {
        battoppos[j] = min(battoppos[j] + 1, 6);
        for (i=0; i<2; i++) lc.setLed(0,battoppos[j] + i, 7*j, true);
      }
    }
  }
// FINE LETTURA POTENZIOMETRO E JOYSTICK
}